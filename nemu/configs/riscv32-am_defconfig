## nemu/configs/riscv32-am_defconfig
```kconfig
CONFIG_TARGET_AM=y
# CONFIG_TRACE is not set
# CONFIG_NPC_VCD_TRACE is not set
# CONFIG_NPC_DIFFTEST_NEMU is not set
# CONFIG_DIFFTEST is not set
CONFIG_MSIZE=0x2000000
CONFIG_RISCV_F=y
```

## nemu/configs/riscv32-fpga-u55c-defconfig
```kconfig
CONFIG_ISA_riscv32=y
# CONFIG_TRACE is not set
# CONFIG_NPC_VCD_TRACE is not set
# CONFIG_NPC_DIFFTEST_NEMU is not set
# CONFIG_DIFFTEST is not set
CONFIG_RISCV_F=y
CONFIG_TARGET_NATIVE_ELF=y
CONFIG_FPGA_BACKEND_U55C=y
CONFIG_WATCHPOINT=y
```

## nemu/configs/riscv32-nemu-interpreter-defconfig
```kconfig
CONFIG_ISA_riscv=y
# CONFIG_TRACE is not set
CONFIG_DEVICE=y
CONFIG_TARGET_NATIVE_ELF=y
```

## nemu/configs/riscv64-fpga-zcu102-defconfig
```kconfig
CONFIG_ISA_riscv=y
CONFIG_RV64=y
# CONFIG_TRACE is not set
# CONFIG_NPC_VCD_TRACE is not set
# CONFIG_NPC_DIFFTEST_NEMU is not set
# CONFIG_DIFFTEST is not set
CONFIG_RISCV_F=y
CONFIG_TARGET_NATIVE_ELF=y
CONFIG_FPGA_BACKEND_ZCU102=y
CONFIG_WATCHPOINT=y
```

## nemu/configs/riscv64-nemu-interpreter-defconfig
```kconfig
CONFIG_ISA_riscv=y
CONFIG_RV64=y
# CONFIG_TRACE is not set
CONFIG_DEVICE=y
CONFIG_TARGET_NATIVE_ELF=y
```

## nemu/src/isa/riscv32/Kconfig
```kconfig
menu "ISA-dependent Options for riscv"

config RV64
  bool "64-bit RISC-V architecture"
  default n

config RVE
  bool "Use E extension"
  default n

config RISCV_F
  depends on !RVE
  bool "Single-precision floating-point extension (F)"
  default y
  help
    Enable the scalar IEEE-754 binary32 RISC-V F extension. NEMU builds a
    private RISC-V-specialized Berkeley SoftFloat archive for this target.
endmenu
```
